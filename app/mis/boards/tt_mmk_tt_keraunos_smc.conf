## app/mis/boards/tt_mmk_tt_keraunos_smc.conf
```kconfig
CONFIG_SHELL_PROMPT_UART="tt_keraunos:~$ "
CONFIG_I3C_CONTROLLER_ROLE_ONLY=y
CONFIG_TT_GR_TELEMETRY=y
```

## drivers/misc/bh_fwtable/Kconfig
```kconfig
# Copyright (c) 2025 Tenstorrent AI ULC
# SPDX-License-Identifier: Apache-2.0

config BH_FWTABLE
	bool "Tenstorrent Blackhole Firmware Table"
	default y
	depends on DT_HAS_TENSTORRENT_BH_FWTABLE_ENABLED && !TT_SMC_RECOVERY
	select TT_BOOT_FS
	help
		Enable the Tenstorrent Blackhole Firmware Table.

		Disabled in SMC recovery builds: recovery must not depend on
		reading the SPI firmware tables during bring-up, so it links the
		static chip-info backend (chip_info_static.c) instead of this
		driver. See lib/tenstorrent/bh_arc/chip_info.h.

if BH_FWTABLE

config BH_FWTABLE_INIT_PRIORITY
	int "Tenstorrent Blackhole firmware table init priority"
	default 90
	help
		Set the initialization priority for the Tenstorrent Blackhole firmware table.

		This priority should be selected so that bh_fwtable is initialized after the SPI
		EEPROM and after the SPI RX sample delay has been trained
		(CONFIG_FLASH_TRAINING_PRIORITY), since the tables are the first thing read from
		flash at the full read frequency.

config BH_FWTABLE_LOAD_ATTEMPTS
	int "Attempts to load each firmware table from flash"
	default 3
	range 1 10
	help
		Number of times a table lookup and read is attempted before the driver gives
		up and leaves the device not ready. The tables are boot-critical: without them
		PCIe stays disabled and the chip is unreachable from the host, so a transient
		SPI read problem is worth a few retries.

config BH_FWTABLE_LOAD_RETRY_DELAY_MS
	int "Delay between firmware table load attempts (ms)"
	default 1
	range 0 100
	help
		Time to wait between consecutive attempts to load a firmware table.

config BH_FWTABLE_CCFGOVR
	bool "Apply ccfgovr override of the cmfwcfg table"
	default y
	help
		Apply ccfgovr override of the cmfwcfg table.

module = BH_FWTABLE
module-str = bh_fwtable
source "subsys/logging/Kconfig.template.log_config"

endif
```

## lib/tenstorrent/bh_arc/Kconfig.tt_pcie_log
```kconfig
# Copyright (c) 2026 Tenstorrent AI ULC
# SPDX-License-Identifier: Apache-2.0

config TT_PCIE_LOG_BACKEND
	bool "Enable Tenstorrent Host tt_pcie_log backend"
	depends on LOG && LOG_MODE_DEFERRED
	default y if SOC_TT_BLACKHOLE_SMC
	select LOG_OUTPUT
	help
	  Enable tt_pcie_log backend that outputs logs to shared host memory buffer
	  via DMA for kernel module consumption. When host is not available,
	  logs are stored in local buffer and transferred when host connects.

config TT_PCIE_LOG_BACKEND_BUFFER_SIZE
	int "Local log buffer size in bytes"
	depends on TT_PCIE_LOG_BACKEND
	default 4096
	help
	  Size of local buffer to aggregate logs into. Logs from this buffer
	  are flushed on a timer, or when approaching capacity, and only if the
	  host has messaged FW the buffer is available.
```

## lib/tenstorrent/gr_smc/Kconfig
```kconfig
# Copyright (c) 2026 Tenstorrent AI ULC
# SPDX-License-Identifier: Apache-2.0

config TT_GR_SMC
	bool "Grendel SMC support library"
	select SIVAL_SDK
	help
	  Enable Tenstorrent Grendel SMC support library components.

config TT_GR_SMC_ERR_STR
	bool "Grendel SMC error-string table (Sival SDK err.c)"
	select TT_GR_SMC
	default n
	help
	  Compile grendel_err_to_str from the grendel-sival-sdk tarball's
	  common/src/err.c

config TT_GR_TELEMETRY
	bool "Grendel telemetry"
	depends on TT_GR_SMC && TT_MSGQUEUE
	depends on DT_HAS_TENSTORRENT_GRENDEL_SMC_DMA_ENABLED
	select DMA
	help
	  Telemetry items that components define with GR_TELEM_ITEM_DEFINE,
	  pushed with their descriptors and static values into a host buffer
	  over PCIe. The host starts and stops pushing with
	  TT_SMC_MSG_GR_TELEMETRY.

if TT_GR_TELEMETRY

config TT_GR_TELEMETRY_MOCK
	bool "Mock power and thermal telemetry"
	default y
	help
	  Publish fixed power and thermal values until the real sensors are
	  wired up.

config TT_GR_TELEMETRY_MAX_ITEMS
	int "Maximum static or dynamic telemetry items"
	default 32
	help
	  Size of the staging buffer for one frame or the static block.

config TT_GR_TELEMETRY_PUSH_PERIOD_DEFAULT_MS
	int "Default push period (ms)"
	default 100
	help
	  Push period used when the host requests a period of 0.

config TT_GR_TELEMETRY_PUSH_PERIOD_MIN_MS
	int "Minimum push period (ms)"
	default 10

config TT_GR_TELEMETRY_DMA_CHANNEL
	int "SMC DMA channel for pushing telemetry"
	default 15

config TT_GR_TELEMETRY_HOST_WINDOW_BASE
	hex "Chip address of host IOVA 0"
	default 0x0
	help
	  Base of the outbound PCIe window through which the SMC DMA reaches
	  host memory. Added to the host buffer IOVA.

endif # TT_GR_TELEMETRY

config TT_GR_SMC_LOG_BRIDGE
	bool "Grendel SMC log bridge"
	depends on LOG
	select TT_GR_SMC
	default n
	help
	  Provide strong log_message/log_with_location overrides for Grendel
	  firmware logging hooks and route them into Zephyr logging.

if TT_GR_SMC_LOG_BRIDGE

module = TT_GR_SMC_LOG_BRIDGE
module-str = Grendel SMC log bridge
source "subsys/logging/Kconfig.template.log_config"

endif # TT_GR_SMC_LOG_BRIDGE
```

## lib/tenstorrent/grendel_noc2axi/Kconfig
```kconfig
# Copyright (c) 2026 Tenstorrent AI ULC
# SPDX-License-Identifier: Apache-2.0

config TT_GRENDEL_NOC2AXI
	bool "Grendel NOC2AXI address translation library"
	depends on SOC_TT_GRENDEL_SMC
	help
	  This option enables the Grendel NOC2AXI library which programs
	  the mask table and SMN endpoint table for AXI-to-NOC address
	  translation.
```

## tests/boards/tenstorrent/tt_grendel_smc/noc2axi/testcase.yaml
```yaml
common:
  tags:
    - smoke
    - noc2axi
tests:
  boards.grendel_smc.noc2axi.basic:
    platform_allow:
      - tt_grendel_smc
```

## tests/drivers/pmci/tt_pldm_oem/testcase.yaml
```yaml
common:
  platform_allow:
    - native_sim
tests:
  drivers.pmci.tt_pldm_oem:
    tags:
      - pmci
      - pldm
      - oem
```

## tests/drivers/tt_d2d/Kconfig
```kconfig
# Copyright (c) 2026 Tenstorrent AI ULC
# SPDX-License-Identifier: Apache-2.0

source "Kconfig.zephyr"

config TT_D2D_TEST_TRAIN
	bool "Build the two-die link training suite instead of the loader suite"
	help
	  Separate image: the loader suite leaves the tile started, which is
	  not where training begins, and only one suite can run on a die.

config TT_D2D_TEST_TRAIN_KERAUNOS
	bool "Train the Mimir1-to-Keraunos link as well"
	depends on TT_D2D_TEST_TRAIN
	help
	  MMK Mimir image: Mimir1 also loads d2d1 (faces Keraunos d2d2).
	  Unused on the Keraunos image.
```
