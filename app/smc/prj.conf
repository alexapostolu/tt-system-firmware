## sample.yaml
```
sample:
  description: Tenstorrent Blackhole Chip Management Firmware
  name: bh-cmfw
common:
  timeout: 180
  platform_allow:
    - tt_blackhole@p100a/tt_blackhole/smc
    - tt_blackhole@p150a/tt_blackhole/smc
    - tt_blackhole@p300a/tt_blackhole/smc
tests:
  app.default: {}
  app.e2e-smoke-flash:
    tags: e2e-flash
    timeout: 720 # 12 minutes
    harness: pytest
    sysbuild: true
    harness_config:
      pytest_root:
        - pytest/e2e_smoke.py
      pytest_args:
        - "--dut-scope=session"
    extra_args:
      - dmc_CONFIG_DMC_RUN_SMBUS_TESTS=y
  app.recovery:
    build_only: true
    extra_overlay_confs:
      - sysbuild/recovery.conf
  app.recovery-flash:
    sysbuild: true
    tags: recovery
    harness: pytest
    harness_config:
      pytest_root:
        - pytest/recovery.py
      pytest_args:
        - "--dut-scope=session"
  app.vuart-bh-1x:
    tags: e2e
    depends_on: bh_1x
    harness: pytest
    harness_config:
      pytest_root:
        - pytest/vuart.py
      pytest_args:
        - "--dut-scope=session"
  app.vuart-bh-2x:
    tags: e2e
    depends_on: bh_2x
    harness: pytest
    harness_config:
      pytest_root:
        - pytest/vuart.py
      pytest_args:
        - "--dut-scope=session"
        - "--asic-id=1"
  app.stress-test:
    # Budget 3 hours for stress testing. Any more and we should consider reducing test coverage
    # nightly, as CI machines might not be available for PR efforts
    timeout: 10800
    tags: e2e-stress
    platform_allow:
      - tt_blackhole@p100a/tt_blackhole/smc
      - tt_blackhole@p150a/tt_blackhole/smc
      - tt_blackhole@p150b/tt_blackhole/smc
      - tt_blackhole@p300a/tt_blackhole/smc
      - tt_blackhole@p300c/tt_blackhole/smc
      - tt_blackhole@galaxy/tt_blackhole/smc
      - tt_blackhole@galaxy_revc/tt_blackhole/smc
    harness: pytest
    sysbuild: true
    extra_args:
      - dmc_CONFIG_DMC_RUN_SMBUS_TESTS=y
    harness_config:
      pytest_root:
        - pytest/e2e_stress.py
      pytest_args:
        - "--dut-scope=session"
        - "--log-cli-level=INFO"
      record:
        regex:
          - >-
            INFO: (?P<test_name>.*) completed.
            Failed (?P<fail_count>\d+)/(?P<total_tries>\d+) times.
  # Runs production firmware tests when compiled with CONFIG_ASSERT=y
  app.e2e-prod-assert:
    tags: e2e-stress
    timeout: 720 # 12 minutes
    harness: pytest
    sysbuild: true
    harness_config:
      pytest_root:
        - pytest/e2e_smoke.py
      pytest_args:
        - "--dut-scope=session"
    extra_args:
      - dmc_CONFIG_DMC_RUN_SMBUS_TESTS=y
      - CONFIG_ASSERT=y
  app.tracing:
    build_only: true
    sysbuild: true
    tags:
      - build-ci
    extra_overlay_confs:
      - tracing.conf
    extra_args:
      - EXTRA_DTC_OVERLAY_FILE=tracing.overlay
  app.tt_shell:
    build_only: true
    sysbuild: false
    tags:
      - build-ci
    extra_configs:
      - CONFIG_SHELL=y
```

## prj.conf
```kconfig
# logging
CONFIG_LOG=y
CONFIG_TT_APP_LOG_LEVEL_INF=y

CONFIG_ARC_USE_UNALIGNED_MEM_ACCESS=y
CONFIG_HW_STACK_PROTECTION=n
CONFIG_SYS_CLOCK_TICKS_PER_SEC=100000
CONFIG_TICKLESS_KERNEL=y

# I2C
CONFIG_MULTI_LEVEL_INTERRUPTS=y
CONFIG_I2C_DW=y
CONFIG_I2C=y
CONFIG_I2C_TARGET=y
CONFIG_SMBUS=y
CONFIG_SMBUS_TARGET=y

# PVT sensor driver
CONFIG_SENSOR=y
CONFIG_RTIO=y
CONFIG_SENSOR_ASYNC_API=y

# stack
# These default to 1024 on ARC.
CONFIG_SYSTEM_WORKQUEUE_STACK_SIZE=2048

# Boot diagnostics for the static-fw-table investigation (not for release):
# fill stacks so the init thread's high-water mark can be published
# (INIT_STACK_HEADROOM_REG_ADDR), and turn a silent stack overflow into a
# fatal error instead of memory corruption.
CONFIG_INIT_STACKS=y
CONFIG_THREAD_STACK_INFO=y
CONFIG_STACK_SENTINEL=y

# Disable printing the default Zephyr boot banner
CONFIG_BOOT_BANNER=n
# Print the Tenstorrent boot banner + git version on startup
CONFIG_TT_BOOT_BANNER=y
CONFIG_TT_BOOT_BANNER_SDK_VERSION=y

# Enable FPU with context switching
CONFIG_FPU=y
CONFIG_FPU_SHARING=y

# Select ramload with revert mode
CONFIG_BOOTLOADER_MCUBOOT=y
CONFIG_MCUBOOT_BOOTLOADER_MODE_RAM_LOAD_WITH_REVERT=y

# Enable the flash manager so we can confirm the image
CONFIG_FLASH=y
CONFIG_FLASH_MAP=y
CONFIG_STREAM_FLASH=y
CONFIG_IMG_MANAGER=y
CONFIG_MCUBOOT_IMG_MANAGER=y

# Enable retained memory and retention
CONFIG_RETAINED_MEM=y
CONFIG_RETENTION=y
CONFIG_RETAINED_MEM_ZEPHYR_RAM=y
CONFIG_RETENTION_BOOTLOADER_INFO=y
CONFIG_RETENTION_BOOTLOADER_INFO_TYPE_MCUBOOT=y

# Generate unsigned images by default
# To sign FW, use SB_CONFIG_BOOT_SIGNATURE_KEY_FILE="/path/to/key.pem"
CONFIG_MCUBOOT_GENERATE_UNSIGNED_IMAGE=y

# Enable the Zbus notification/observer subsystem.
CONFIG_ZBUS=y
CONFIG_ZBUS_RUNTIME_OBSERVERS_NODE_ALLOC_NONE=y

# Binary descriptors for firmware version
CONFIG_BINDESC=y
CONFIG_BINDESC_DEFINE=y
CONFIG_BINDESC_DEFINE_VERSION=y
CONFIG_BINDESC_APP_VERSION_STRING=y
CONFIG_TT_BINDESC=y
```

## src/main.c
```c
/*
 * Copyright (c) 2024 Tenstorrent AI ULC
 * SPDX-License-Identifier: Apache-2.0
 */

#include "cat.h"
#include "cm2dm_msg.h"
#include "dvfs.h"
#include "fan_ctrl.h"
#include "init.h"
#include "reg.h"
#include "smbus_target.h"
#include "status_reg.h"
#include "telemetry.h"
#include "timer.h"

#include <stdint.h>

#include <app_version.h>
#include <tenstorrent/post_code.h>
#include <tenstorrent/sys_init_defines.h>
#include <zephyr/init.h>
#include <zephyr/kernel.h>
#include <zephyr/logging/log.h>
#include <zephyr/drivers/watchdog.h>
#include <zephyr/storage/flash_map.h>
#include <zephyr/dfu/mcuboot.h>
#ifdef CONFIG_BH_FWTABLE
#include <zephyr/drivers/misc/bh_fwtable.h>
#endif

LOG_MODULE_REGISTER(main, CONFIG_TT_APP_LOG_LEVEL);

static const struct device *const wdt0 = DEVICE_DT_GET(DT_NODELABEL(wdt0));
#ifdef CONFIG_BH_FWTABLE
static const struct device *const fwtable_dev = DEVICE_DT_GET(DT_NODELABEL(fwtable));
#endif

BUILD_ASSERT(PARTITION_EXISTS(cmfw), "cmfw fixed-partition does not exist");

int main(void)
{
	SetPostCode(POST_CODE_SRC_CMFW, POST_CODE_ZEPHYR_INIT_DONE);
	printk("Tenstorrent Blackhole CMFW %s\n", APP_VERSION_STRING);

#ifdef CONFIG_BH_FWTABLE
	if (tt_bh_fwtable_get_fw_table(fwtable_dev)->feature_enable.aiclk_ppm_en) {
		uint32_t err0 = ReadReg(STATUS_ERROR_STATUS0_REG_ADDR);

		if (err0 & BIT(INIT_STAGE_REGULATOR)) {
			LOG_ERR("Not enabling AICLK PPM due to regulator init error");
		} else {
			/* DVFS should get enabled if AICLK PPM or L2CPUCLK PPM is enabled
			 * We currently don't have plans to implement L2CPUCLK PPM,
			 * so currently, dvfs_enable == aiclk_ppm_enable
			 */
			InitDVFS();
		}
	}
#endif

#ifdef CONFIG_BH_FWTABLE
	init_telemetry(APPVERSION);
	if (tt_bh_fwtable_get_fw_table(fwtable_dev)->feature_enable.fan_ctrl_en) {
		init_fan_ctrl();
	}

	/* These timers are split out from their init functions since their work tasks have
	 * i2c conflicts with other init functions.
	 *
	 * Note: The above issue would be solved by using Zephyr's driver model.
	 */
	StartTelemetryTimer();
	if (dvfs_enabled) {
		StartDVFSTimer();
	}
	StartGddrThermTripMonitor();
#endif

	Dm2CmReadyRequest();

#ifdef CONFIG_BOOTLOADER_MCUBOOT
	int rc;

	/* For now, if we make it here than we passed the BIST and will confirm the image */
	if (!boot_is_img_confirmed()) {
		rc = boot_write_img_confirmed();
		if (rc < 0) {
			return rc;
		}
		printk("Firmware update is confirmed.\n");
	}
#endif

	while (1) {
		sys_trace_named_event("main_loop", TimerTimestamp(), 0);
		k_msleep(CONFIG_TT_BH_ARC_WDT_FEED_INTERVAL);
		wdt_feed(wdt0, 0);
	}

	return 0;
}

#define FW_VERSION_SEMANTIC APPVERSION
#define FW_VERSION_DATE     0x00000000
#define FW_VERSION_LOW      0x00000000
#define FW_VERSION_HIGH     0x00000000

uint32_t FW_VERSION[4] __attribute__((section(".fw_version"))) = {
	FW_VERSION_SEMANTIC, FW_VERSION_DATE, FW_VERSION_LOW, FW_VERSION_HIGH};

static int tt_appversion_init(void)
{
	WriteReg(STATUS_FW_VERSION_REG_ADDR, APPVERSION);
	return 0;
}
SYS_INIT(tt_appversion_init, EARLY, 0);

static int record_cmfw_start_time(void)
{
	WriteReg(CMFW_START_TIME_REG_ADDR, TimerTimestamp());
	return 0;
}
SYS_INIT(record_cmfw_start_time, EARLY, 0);

static int bh_arc_init_start(void)
{
	/* Write a status register indicating HW init progress */
	STATUS_BOOT_STATUS0_reg_u boot_status0 = {0};

	boot_status0.val = ReadReg(STATUS_BOOT_STATUS0_REG_ADDR);
	boot_status0.f.hw_init_status = kHwInitStarted;
	WriteReg(STATUS_BOOT_STATUS0_REG_ADDR, boot_status0.val);

	SetPostCode(POST_CODE_SRC_CMFW, POST_CODE_ARC_INIT_STEP1);
	SetPostCode(POST_CODE_SRC_CMFW, POST_CODE_ARC_INIT_STEP2);

	return 0;
}
SYS_INIT_APP(bh_arc_init_start);

static int bh_arc_init_end(void)
{
	STATUS_BOOT_STATUS0_reg_u boot_status0 = {0};

	/* Indicate successful HW Init */
	boot_status0.val = ReadReg(STATUS_BOOT_STATUS0_REG_ADDR);
	/* Record FW ID */
	if (IS_ENABLED(CONFIG_TT_SMC_RECOVERY)) {
		boot_status0.f.fw_id = FW_ID_SMC_RECOVERY;
	} else {
		boot_status0.f.fw_id = FW_ID_SMC_NORMAL;
	}

	boot_status0.f.hw_init_status = (error_status0 != 0) ? kHwInitError : kHwInitDone;
	WriteReg(STATUS_BOOT_STATUS0_REG_ADDR, boot_status0.val);
	WriteReg(STATUS_ERROR_STATUS0_REG_ADDR, error_status0);

	return 0;
}
SYS_INIT_APP(bh_arc_init_end);
```
